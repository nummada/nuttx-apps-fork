## coaputils/coap/Kconfig
```kconfig
#
# For a description of the syntax of this configuration file,
# see the file kconfig-language.txt in the NuttX tools repository.
#

config COAPUTILS_COAP_LIB
	bool "Coap Library"
	default n
	---help---
		TODO coap lib

if COAPUTILS_COAP_LIB
endif
```

## examples/coap/Kconfig
```kconfig
#
# For a description of the syntax of this configuration file,
# see the file kconfig-language.txt in the NuttX tools repository.
#

config EXAMPLES_COAP
	tristate "COAP example"
	default y
	select COAPUTILS_COAP_LIB
	---help---
		Enable the COAP example

if EXAMPLES_COAP

config EXAMPLES_COAP_PROGNAME
	string "Program name"
	default "coap_example_plua_mea"
	---help---
		This is the name of the program that will be used when the NSH ELF
		program is installed.

config EXAMPLES_COAP_PRIORITY
	int "Coap task priority"
	default 100

config EXAMPLES_COAP_STACKSIZE
	int "Coap stack size"
	default DEFAULT_TASK_STACKSIZE

endif
```
